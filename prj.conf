## CMakeLists.txt
```
# SPDX-License-Identifier: Apache-2.0

cmake_minimum_required(VERSION 3.20.0)

find_package(Zephyr REQUIRED HINTS $ENV{ZEPHYR_BASE})
project(hello_world)

target_sources(app PRIVATE src/main.c src/ConfigurationCreator.c src/PacketBuilder.c src/MAX30100.c)
```

## prj.conf
```kconfig
# Enable the I2C driver
CONFIG_I2C=y

# Enable floating point format specifiers
CONFIG_CBPRINTF_FP_SUPPORT=y
```

## src/main.c
```c
/*
 * Copyright (c) 2022
 */

#include <zephyr.h>
#include <device.h>
#include <drivers/gpio.h>
#include <devicetree.h>
#include <stddef.h>
#include <string.h>



#include "MAX30100.h"

#include <bluetooth/bluetooth.h>
#include <bluetooth/hci.h>
#include <bluetooth/conn.h>
#include <bluetooth/uuid.h>
#include <bluetooth/gatt.h>
#include <bluetooth/services/hrs.h>

#define SLEEP_TIME_MS 1000
#define DC_REMOVER_ALPHA 0.95

float removeDCComponent(float value, float alpha)
{
    static float dcw = 0;
    float oldDcw = dcw;

    dcw = (float)value + alpha * dcw;

	return dcw - oldDcw;
}

void functionToGetSensorData(uint16_t IR, uint16_t RED)
{
    float IRInAC = removeDCComponent(IR, DC_REMOVER_ALPHA);
    float REDInAC = removeDCComponent(RED, DC_REMOVER_ALPHA);

    float R = (REDInAC / RED) / (IRInAC / IR);

    float SpO2 = 90 - (20 * R);

    printk("\nSpO2: %f", SpO2);
}

void main(void)
{
	MAX30100_Init();

	ConfigCreatorMode_SetSensorMode(SpO2);
	ConfigCreatorLED_SetLEDCurrentForIR(mA_50);
	ConfigCreatorLED_SetLEDCurrentForRED(mA_27_1);
	ConfigCreatorSpO2_SetLEDPulseWidth(us1600);
	ConfigCreatorSpO2_SetHighResolutionControl(true);

	ConfigParams cfgMode = ConfigCreatorMode_Build();
	ConfigParams cfgSpO2 = ConfigCreatorSpO2_Build();
	ConfigParams cfdLED = ConfigCreatorLED_Build();

	MAX30100_SendConfigRegister(&cfgMode);
	MAX30100_SendConfigRegister(&cfgSpO2);
	MAX30100_SendConfigRegister(&cfdLED);





	while(1)
	{
		MAX30100_ReadData(functionToGetSensorData);
		hrs_notify();
		k_msleep(100);
	
	}
}
```

## src/ConfigurationCreator.c
```c
#include "ConfigurationCreator.h"


static ConfigModeBundle cfgModeRegister = { .regAddr = MAX30100_MODE_CONFIG,
                                            .shutdownControlEnabled = false,
                                            .resetControlEnabled = false,
                                            .temperatureControlEnabled = false,
                                            .mode = HR };

static SpO2Bundle spo2Register = { .regAddr = MAX30100_SPO2_CONFIG,
                                   .highResolutionEnabled = false,
                                   .rate = Hz100,
                                   .width = us400 };

static LEDConfigBundle cfgLEDRegister = { .regAddr = MAX30100_LED_CONFIG,
                                          .currentForIR = mA_24,
                                          .currentForRED = mA_24 };

void ConfigCreatorMode_SetShutdownControl(bool shutdownCtrEnabled)
{
    cfgModeRegister.shutdownControlEnabled = shutdownCtrEnabled;
}

void ConfigCreatorMode_SetResetControl(bool resetCtrEnabled)
{
    cfgModeRegister.resetControlEnabled = resetCtrEnabled;
}

void ConfigCreatorMode_SetTemperatureControl(bool temperatureCtrEnabled)
{
    cfgModeRegister.temperatureControlEnabled = temperatureCtrEnabled;
}

void ConfigCreatorMode_SetSensorMode(SensorMode mode)
{
    cfgModeRegister.mode = mode;
}

ConfigParams ConfigCreatorMode_Build()
{
    char configFrame[BITS_IN_BYTE];

    cfgModeRegister.shutdownControlEnabled ? 
        PacketBuilder_SetHighBit(&configFrame, BIT7) :
        PacketBuilder_SetLowBit(&configFrame, BIT7);

    cfgModeRegister.resetControlEnabled ? 
        PacketBuilder_SetHighBit(&configFrame, BIT6) :
        PacketBuilder_SetLowBit(&configFrame, BIT6);

    cfgModeRegister.temperatureControlEnabled ? 
        PacketBuilder_SetHighBit(&configFrame, BIT3) :
        PacketBuilder_SetLowBit(&configFrame, BIT3);

    bool secondModeBit = ((cfgModeRegister.mode >> 2)  & 0x01);
    bool firstModeBit = ((cfgModeRegister.mode >> 1)  & 0x01);
    bool zeroModeBit = ((cfgModeRegister.mode >> 0)  & 0x01);

    secondModeBit ?
        PacketBuilder_SetHighBit(&configFrame, BIT2) :
        PacketBuilder_SetLowBit(&configFrame, BIT2);

    firstModeBit ?
        PacketBuilder_SetHighBit(&configFrame, BIT1) :
        PacketBuilder_SetLowBit(&configFrame, BIT1);

    zeroModeBit ?
        PacketBuilder_SetHighBit(&configFrame, BIT0) :
        PacketBuilder_SetLowBit(&configFrame, BIT0);

    PacketBuilder_FillOthersToLow(&configFrame);

    ConfigParams rType = { .reg = cfgModeRegister.regAddr,
                           .config = PacketBuilder_ConvertToHex(&configFrame)};
    return rType;
}

void ConfigCreatorSpO2_SetHighResolutionControl(bool highResEnabled)
{
    spo2Register.highResolutionEnabled = highResEnabled;
}

void ConfigCreatorSpO2_SetSampleRate(SampleRate sampleRate)
{
    spo2Register.rate = sampleRate;
}

void ConfigCreatorSpO2_SetLEDPulseWidth(LEDPulseWidth width)
{
    spo2Register.width = width;
}

ConfigParams ConfigCreatorSpO2_Build()
{
    char configFrame[BITS_IN_BYTE];

    spo2Register.highResolutionEnabled ?
        PacketBuilder_SetHighBit(&configFrame, BIT6) :
        PacketBuilder_SetLowBit(&configFrame, BIT6);

    bool secondRateBit = ((spo2Register.rate >> 2)  & 0x01);
    bool firstRateBit = ((spo2Register.rate >> 1)  & 0x01);
    bool zeroRateBit = ((spo2Register.rate >> 0)  & 0x01);

    secondRateBit ?
        PacketBuilder_SetHighBit(&configFrame, BIT4) :
        PacketBuilder_SetLowBit(&configFrame, BIT4);

    firstRateBit ?
        PacketBuilder_SetHighBit(&configFrame, BIT3) :
        PacketBuilder_SetLowBit(&configFrame, BIT3);

    zeroRateBit ?
        PacketBuilder_SetHighBit(&configFrame, BIT2) :
        PacketBuilder_SetLowBit(&configFrame, BIT2);

    bool firstWidthBit = ((spo2Register.width >> 1)  & 0x01);
    bool zeroWidthBit = ((spo2Register.width >> 0)  & 0x01);

    firstWidthBit ?
        PacketBuilder_SetHighBit(&configFrame, BIT1) :
        PacketBuilder_SetLowBit(&configFrame, BIT1);

    zeroWidthBit ?
        PacketBuilder_SetHighBit(&configFrame, BIT0) :
        PacketBuilder_SetLowBit(&configFrame, BIT0);

    PacketBuilder_FillOthersToLow(&configFrame);
    ConfigParams rType = { .reg = spo2Register.regAddr,
                           .config = PacketBuilder_ConvertToHex(&configFrame)};
    return rType;
}

void ConfigCreatorLED_SetLEDCurrentForIR(LEDCurrent current)
{
    cfgLEDRegister.currentForIR = current;
}

void ConfigCreatorLED_SetLEDCurrentForRED(LEDCurrent current)
{
    cfgLEDRegister.currentForRED = current;
}

ConfigParams ConfigCreatorLED_Build()
{
    char configFrame[BITS_IN_BYTE];

    bool thirdIRBit = ((cfgLEDRegister.currentForIR >> 3)  & 0x01);
    bool secondIRBit = ((cfgLEDRegister.currentForIR >> 2)  & 0x01);
    bool firstIRBit = ((cfgLEDRegister.currentForIR >> 1)  & 0x01);
    bool zeroIRBit = ((cfgLEDRegister.currentForIR >> 0)  & 0x01);

    thirdIRBit ?
        PacketBuilder_SetHighBit(&configFrame, BIT3) :
        PacketBuilder_SetLowBit(&configFrame, BIT3);

    secondIRBit ?
        PacketBuilder_SetHighBit(&configFrame, BIT2) :
        PacketBuilder_SetLowBit(&configFrame, BIT2);

    firstIRBit ?
        PacketBuilder_SetHighBit(&configFrame, BIT1) :
        PacketBuilder_SetLowBit(&configFrame, BIT1);

    zeroIRBit ?
        PacketBuilder_SetHighBit(&configFrame, BIT0) :
        PacketBuilder_SetLowBit(&configFrame, BIT0);

    bool thirdREDBit = ((cfgLEDRegister.currentForRED >> 3)  & 0x01);
    bool secondREDBit = ((cfgLEDRegister.currentForRED >> 2)  & 0x01);
    bool firstREDBit = ((cfgLEDRegister.currentForRED >> 1)  & 0x01);
    bool zeroREDBit = ((cfgLEDRegister.currentForRED >> 0)  & 0x01);

    thirdREDBit ?
        PacketBuilder_SetHighBit(&configFrame, BIT7) :
        PacketBuilder_SetLowBit(&configFrame, BIT7);

    secondREDBit ?
        PacketBuilder_SetHighBit(&configFrame, BIT6) :
        PacketBuilder_SetLowBit(&configFrame, BIT6);

    firstREDBit ?
        PacketBuilder_SetHighBit(&configFrame, BIT5) :
        PacketBuilder_SetLowBit(&configFrame, BIT5);

    zeroREDBit ?
        PacketBuilder_SetHighBit(&configFrame, BIT4) :
        PacketBuilder_SetLowBit(&configFrame, BIT4);

    PacketBuilder_FillOthersToLow(&configFrame);
    ConfigParams rType = { .reg = cfgLEDRegister.regAddr,
                           .config = PacketBuilder_ConvertToHex(&configFrame)};
    return rType;
}
```

## src/ConfigurationCreator.h
```c
#ifndef CONFIGURATIONCREATOR_H
#define CONFIGURATIONCREATOR_H

#include <stdbool.h>

#include "PacketBuilder.h"

#define MAX30100_I2C_ADDRESS 0x57

#define FIFO_DEPTH 16

// fifo-related registers
#define MAX30100_FIFO_WR_PTR    0x02  // Where data is being written
#define MAX30100_OVRFLOW_CTR    0x03  // Number of lost samples
#define MAX30100_FIFO_RD_PTR    0x04  // Where to read from
#define MAX30100_FIFO_DATA      0x05  // Ouput data buffer

// other registers
#define MAX30100_MODE_CONFIG    0x06  // Control register
#define MAX30100_SPO2_CONFIG    0x07  // Pulse oximetry settings
#define MAX30100_LED_CONFIG     0x09  // Pulse width and power of LEDs
#define MAX30100_TEMP_INTG      0x16  // Temperature value, whole number
#define MAX30100_TEMP_FRAC      0x17  // Temperature value, fraction

typedef struct
{
    uint8_t reg;
    uint8_t config;
} ConfigParams;

typedef enum
{
    Unused   = 0x00,
    Reserved = 0x01, /* unused */
    HR       = 0x02, /* HR only enabled*/
    SpO2     = 0x03  /* HR & SpO2 enabled */
} SensorMode;

// ConfigModeBundle - Config Mode register

typedef struct
{
    const uint8_t regAddr;

    bool shutdownControlEnabled;
    bool resetControlEnabled;
    bool temperatureControlEnabled;
    SensorMode mode;
} ConfigModeBundle;

void ConfigCreatorMode_SetShutdownControl(bool shutdownCtrEnabled);
void ConfigCreatorMode_SetResetControl(bool resetCtrEnabled);
void ConfigCreatorMode_SetTemperatureControl(bool temperatureCtrEnabled);
void ConfigCreatorMode_SetSensorMode(SensorMode mode);

ConfigParams ConfigCreatorMode_Build();

typedef enum
{
    Hz50   = 0x00,
    Hz100  = 0x01,
    Hz167  = 0x02,
    Hz200  = 0x03,
    Hz400  = 0x04,
    Hz600  = 0x05,
    Hz800  = 0x06,
    Hz1000 = 0x07
} SampleRate;

typedef enum
{
    us200  = 0x00,
    us400  = 0x01,
    us800  = 0x02,
    us1600 = 0x03
} LEDPulseWidth;

// SpO2Bundle - SpO2 register

typedef struct
{
    const uint8_t regAddr;

    bool highResolutionEnabled;
    SampleRate rate;
    LEDPulseWidth width;
} SpO2Bundle;

void ConfigCreatorSpO2_SetHighResolutionControl(bool highResEnabled);
void ConfigCreatorSpO2_SetSampleRate(SampleRate sampleRate);
void ConfigCreatorSpO2_SetLEDPulseWidth(LEDPulseWidth width);

ConfigParams ConfigCreatorSpO2_Build();

typedef enum
{
    mA_0    = 0x00,
    mA_4_4  = 0x01,
    mA_7_6  = 0x02,
    mA_11   = 0x03,
    mA_14_2 = 0x04,
    mA_17_4 = 0x05,
    mA_20_8 = 0x06,
    mA_24   = 0x07,
    mA_27_1 = 0x08,
    mA_30_6 = 0x09,
    mA_33_8 = 0x0A,
    mA_37   = 0x0B,
    mA_40_2 = 0x0C,
    mA_43_6 = 0x0D,
    mA_46_8 = 0x0E,
    mA_50   = 0x0F
} LEDCurrent;

// LEDConfigBundle - LED Config register

typedef struct
{
    const uint8_t regAddr;

    LEDCurrent currentForIR;
    LEDCurrent currentForRED;
} LEDConfigBundle;

void ConfigCreatorLED_SetLEDCurrentForIR(LEDCurrent current);
void ConfigCreatorLED_SetLEDCurrentForRED(LEDCurrent current);

ConfigParams ConfigCreatorLED_Build();

#endif /* CONFIGURATIONCREATOR_H */
```

## src/MAX30100.c
```c
#include <drivers/i2c.h> //include the header file of the I2C API
#include <inttypes.h>
#include <stdio.h>
/* The devicetree node identifier for the "i2c0" */
#define I2C0_NODE DT_NODELABEL(i2c0)
#if DT_NODE_HAS_STATUS(I2C0_NODE, okay)
#define I2C0	DT_LABEL(I2C0_NODE)
#else
/* A build error here means your board does not have I2C enabled. */
#error "i2c0 devicetree node is disabled"
#define I2C0	""
#endif

#include "MAX30100.h"
const static struct device *dev_i2c;

static uint8_t readRegister(uint8_t address)
{
    uint8_t result = 0;
    i2c_write_read(dev_i2c, MAX30100_I2C_ADDRESS, &address, 1, &result, 1);

    return result;
}

static uint8_t getFifoSize()
{
    uint8_t writePtr = readRegister(MAX30100_FIFO_WR_PTR);
    uint8_t readPtr = readRegister(MAX30100_FIFO_RD_PTR);

    printk("Register value: %u\n", writePtr);
    printk("Register value: %u\n", readPtr);

    return (writePtr - readPtr) & 15;
}

void MAX30100_Init()
{
    dev_i2c = device_get_binding(I2C0);

	if (dev_i2c == NULL)
	{
		printk("Could not find  %s!\n\r", I2C0);
	}
}

void MAX30100_SendConfigRegister(const ConfigParams* params)
{
    uint8_t buffer[2] = {params->reg, params->config};
    i2c_write(dev_i2c, buffer, sizeof(buffer), MAX30100_I2C_ADDRESS);
}

void MAX30100_ReadData(ReceivedCallback onDataReceived)
{
    uint8_t buffer[4 * FIFO_DEPTH] = {0};

    uint8_t fifoSize = getFifoSize();
    printk("FIFO SIZE: %u\n", fifoSize);

    if(fifoSize <= 0)
        return;

    uint16_t IR = 0;
    uint16_t RED = 0;

    i2c_burst_read(dev_i2c, MAX30100_I2C_ADDRESS, MAX30100_FIFO_DATA, buffer, 4 * fifoSize);

    for (uint8_t i=0; i < fifoSize; ++i)
    {
        IR = (uint16_t)((buffer[i*4] << 8) | buffer[i*4 + 1]),
        RED = (uint16_t)((buffer[i*4 + 2] << 8) | buffer[i*4 + 3]);
	onDataReceived(IR, RED);
    }
}
```

## src/MAX30100.h
```c
#ifndef MAX30100_H
#define MAX30100_H

#include <sys/printk.h>

#include "ConfigurationCreator.h"

typedef void (*ReceivedCallback)(uint16_t, uint16_t);

void MAX30100_Init();
void MAX30100_SendConfigRegister(const ConfigParams* params);
void MAX30100_ReadData(ReceivedCallback onDataReceived);

#endif /* MAX30100 */
```

## src/PacketBuilder.c
```c
#include <assert.h>
#include <stdlib.h>
#include "PacketBuilder.h"

void PacketBuilder_SetHighBit(char (*binaryRep)[BITS_IN_BYTE], BytePosition pos)
{
    assert(binaryRep);
    assert(pos <= BITS_IN_BYTE);

    *(*(binaryRep) + pos) = '1';
}

void PacketBuilder_SetLowBit(char (*binaryRep)[BITS_IN_BYTE], BytePosition pos)
{
    assert(binaryRep);
    assert(pos <= BITS_IN_BYTE);

    *(*(binaryRep) + pos) = '0';
}

void PacketBuilder_FillOthersToLow(char (*binaryRep)[BITS_IN_BYTE])
{
    assert(binaryRep);

    for(uint8_t i = 0; i < BITS_IN_BYTE; ++i)
    {
        if(*(*(binaryRep) + i) != '1')
        {
            *(*(binaryRep) + i) = '0';
        }
    }
}

uint8_t PacketBuilder_ConvertToHex(char(*binaryRep)[BITS_IN_BYTE])
{
    return strtol(*binaryRep, NULL, 2);
}
```

## src/PacketBuilder.h
```c
#ifndef PACKETBUILDER_H
#define PACKETBUILDER_H

#include <inttypes.h>

#define BITS_IN_BYTE 8

typedef enum
{
    BIT0 = 0x07,
    BIT1 = 0x06,
    BIT2 = 0x05,
    BIT3 = 0x04,
    BIT4 = 0x03,
    BIT5 = 0x02,
    BIT6 = 0x01,
    BIT7 = 0x00
} BytePosition;

void PacketBuilder_SetHighBit(char (*binaryRep)[BITS_IN_BYTE], BytePosition pos);
void PacketBuilder_SetLowBit(char (*binaryRep)[BITS_IN_BYTE], BytePosition pos);
void PacketBuilder_FillOthersToLow(char (*binaryRep)[BITS_IN_BYTE]);
uint8_t PacketBuilder_ConvertToHex(char (*binaryRep)[BITS_IN_BYTE]);

#endif /* PACKETBUILDER_H */
```
